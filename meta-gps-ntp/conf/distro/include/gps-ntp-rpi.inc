## meta-gps-ntp/conf/distro/include/gps-ntp-rpi.inc
```bitbake
# Enable primary UART for NMEA from GPS receiver. We do not want to use it as console, so dont use ENABLE_UART
ENABLE_UART = "0"
RPI_EXTRA_CONFIG_append = "\nenable_uart=1\n"

# Disable Bluetooth to free up UART for GPS.
RPI_EXTRA_CONFIG_append = "\ndtoverlay=disable-bt\n"

# Configure PPS capture on GPIO18 (pin 12).
RPI_EXTRA_CONFIG_append = "\ndtoverlay=pps-gpio,gpiopin=18\n"
```

## meta-gps-ntp/conf/layer.conf
```bitbake
# We have a conf and classes directory, add to BBPATH
BBPATH .= ":${LAYERDIR}"

# We have recipes-* directories, add to BBFILES
BBFILES += "${LAYERDIR}/recipes-*/*/*.bb \
            ${LAYERDIR}/recipes-*/*/*.bbappend"

BBFILE_COLLECTIONS += "gpsntp"
BBFILE_PATTERN_gpsntp = "^${LAYERDIR}/"
BBFILE_PRIORITY_gpsntp = "8"

LAYERDEPENDS_gpsntp = "core openembedded-layer meta-python networking-layer"
LAYERSERIES_COMPAT_gpsntp = "dunfell"
```
